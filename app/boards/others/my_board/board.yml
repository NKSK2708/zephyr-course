## app/boards/others/my_board/board.yml
```yaml
board:
  name: my_board
  full_name: my board
  vendor: others
  socs:
    - name: stm32f446xx
```

## boards/others/our_board/board.yml
```yaml
board:
  name: our_board
  full_name: our board
  vendor: others
  socs:
    - name: stm32f446xx
```
